#include "../../config/totem.keymap"
#include <dt-bindings/zmk/kscan_mock.h>
#include <dt-bindings/zmk/matrix_transform.h>
/ { chosen { zmk,matrix-transform = &test_transform; }; test_transform: test_transform { compatible = "zmk,matrix-transform"; columns = <10>; rows = <4>; map = < RC(0,0) RC(0,1) RC(0,2) RC(0,3) RC(0,4) RC(0,5) RC(0,6) RC(0,7) RC(0,8) RC(0,9) RC(1,0) RC(1,1) RC(1,2) RC(1,3) RC(1,4) RC(1,5) RC(1,6) RC(1,7) RC(1,8) RC(1,9) RC(3,0) RC(2,0) RC(2,1) RC(2,2) RC(2,3) RC(2,4) RC(2,5) RC(2,6) RC(2,7) RC(2,8) RC(2,9) RC(3,9) RC(3,2) RC(3,3) RC(3,4) RC(3,5) RC(3,6) RC(3,7) >; }; };
&kscan { rows = <4>; columns = <10>; };
 &kscan { events = <ZMK_MOCK_PRESS(3,4,10) ZMK_MOCK_RELEASE(3,4,30) ZMK_MOCK_PRESS(3,4,30) ZMK_MOCK_RELEASE(3,4,30) ZMK_MOCK_PRESS(3,4,30) ZMK_MOCK_PRESS(3,5,10) ZMK_MOCK_PRESS(0,1,10) ZMK_MOCK_RELEASE(0,1,10) ZMK_MOCK_RELEASE(3,5,10) ZMK_MOCK_RELEASE(3,4,50) ZMK_MOCK_PRESS(3,4,30) ZMK_MOCK_RELEASE(3,4,30) ZMK_MOCK_PRESS(3,4,30) ZMK_MOCK_RELEASE(3,4,30) ZMK_MOCK_PRESS(1,2,10) ZMK_MOCK_RELEASE(1,2,100)>; };
