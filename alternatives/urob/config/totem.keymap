/* Wireless TOTEM / XIAO nRF52840, Mac Colemak-DH. */
#define CONFIG_WIRELESS
#include "keypos.h"

/* Extras remain available on every layer. LH/RH each contain two bindings. */
#define ZMK_BASE_LAYER(name, LT, RT, LM, RM, LB, RB, LH, RH) \
    ZMK_LAYER(name, LT RT LM RM \
        &kp LC(LA(LS(LGUI))) LB RB &kp LC(LA(LSHFT)) \
        &kp TAB LH RH &kp BSPC)

#include "base.keymap"
