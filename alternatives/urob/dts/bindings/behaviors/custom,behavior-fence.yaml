## alternatives/urob/dts/bindings/behaviors/custom,behavior-fence.yaml
```yaml
description: Grave key with Command-Shift Markdown fence shortcut
compatible: "custom,behavior-fence"
include: zero_param.yaml
```

## alternatives/v8-multialpha/config/west.yml
```yaml
manifest:
  remotes:
    - name: zmkfirmware
      url-base: https://github.com/zmkfirmware
    - name: urob
      url-base: https://github.com/urob
  projects:
    - name: zmk
      remote: zmkfirmware
      revision: 4dd95d7840eb3d5a3f59bb29fbf1ab054715ef85
      import: app/west.yml
    - name: zmk-auto-layer
      remote: urob
      revision: b50d514219c5ad61198f9a8be137c59d0674b11c
  self:
    path: config
```

## alternatives/v8-multialpha/dts/bindings/behaviors/custom,behavior-direct-fence.yaml
```yaml
description: Direct Raycast fenced-block trigger
compatible: "custom,behavior-direct-fence"
include: zero_param.yaml
```

## alternatives/v8-multialpha/dts/bindings/behaviors/custom,behavior-fence-finish.yaml
```yaml
description: Internal end-of-fence-macro marker
compatible: "custom,behavior-fence-finish"
include: zero_param.yaml
```

## alternatives/v8-multialpha/dts/bindings/behaviors/custom,behavior-layout-select.yaml
```yaml
description: Select an alphabet after cancelling active Num Word
compatible: "custom,behavior-layout-select"
include: one_param.yaml
```

## dts/bindings/behaviors/custom,behavior-combo-fence.yaml
```yaml
description: Command-aware backtick chord
compatible: "custom,behavior-combo-fence"
include: zero_param.yaml
```
